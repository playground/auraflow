## src/firmware/c/sdkconfig.defaults
```kconfig
# AuraFlow ESP-IDF defaults.
# These are baseline configs applied on top of ESP-IDF's built-in defaults.
# Per-developer tweaks can go in sdkconfig (gitignored).

# ── Flash + partition layout ───────────────────────────────────
CONFIG_ESPTOOLPY_FLASHSIZE_4MB=y
CONFIG_PARTITION_TABLE_CUSTOM=y
CONFIG_PARTITION_TABLE_CUSTOM_FILENAME="partitions.csv"
CONFIG_PARTITION_TABLE_OFFSET=0x8000

# ── Logging ────────────────────────────────────────────────────
CONFIG_LOG_DEFAULT_LEVEL_INFO=y

# ── FreeRTOS ───────────────────────────────────────────────────
# Default 100 Hz tick is fine for a sensor that polls every 5–30 s.
CONFIG_FREERTOS_HZ=100

# ── Wi-Fi (defaults — actual creds come from NVS via the
#    provisioning protocol; these only affect driver defaults) ──
CONFIG_ESP_WIFI_STATIC_RX_BUFFER_NUM=10
CONFIG_ESP_WIFI_DYNAMIC_RX_BUFFER_NUM=32

# ── OTA ────────────────────────────────────────────────────────
# Allow plain HTTP OTA URLs. Without this the esp_https_ota begin()
# call rejects http://… with "No option for server verification is
# enabled in esp_http_client config" / ESP_ERR_INVALID_ARG. Acceptable
# for LAN-side updates (the maker-targeted scenario). HTTPS still
# works when callers supply a cert_pem / crt_bundle.
CONFIG_ESP_HTTPS_OTA_ALLOW_HTTP=y
```
